## firmware/xiaozhi-esp32/sdkconfig.defaults.custom
```kconfig
# 自定义唤醒词固件：艾尔赛 ESP32S3-AI-MAIN + 「你好小布」
CONFIG_BOARD_TYPE_ESP32S3_AI_MAIN=y

# 唤醒词：关闭 WakeNet，使用 MultiNet 自定义唤醒词
CONFIG_USE_AFE_WAKE_WORD=n
CONFIG_USE_ESP_WAKE_WORD=n
CONFIG_USE_CUSTOM_WAKE_WORD=y
CONFIG_CUSTOM_WAKE_WORD="ni hao xiao bu"
CONFIG_CUSTOM_WAKE_WORD_DISPLAY="你好小布"
CONFIG_CUSTOM_WAKE_WORD_THRESHOLD=8

# 模型分区：自定义唤醒词专用布局（model 4MB / ota 6M）
CONFIG_PARTITION_TABLE_CUSTOM_FILENAME="partitions/v1/16m_custom_wakeword.csv"

# 中文 MultiNet 模型（自定义命令词/唤醒词靠它）
CONFIG_SR_MN_CN_MULTINET7_QUANT=y
CONFIG_SR_WN_WN9_NIHAOXIAOZHI_TTS=n
CONFIG_USE_AUDIO_PROCESSOR=y

# AI-MAIN BLE HID mouse, alongside Wi-Fi voice.
CONFIG_BT_ENABLED=y
CONFIG_BT_BLUEDROID_ENABLED=y
CONFIG_BT_BLE_ENABLED=y
CONFIG_BT_BLE_42_FEATURES_SUPPORTED=y
```
